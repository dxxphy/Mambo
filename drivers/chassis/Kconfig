## drivers/chassis/Kconfig
```kconfig
# Chassis driver configuration options

# Copyright (c) 2025 ttwards <12411711@mail.sustech.edu.cn>
# SPDX-License-Identifier: Apache-2.0

menuconfig CHASSIS
    bool "Chassis drivers"
	select WHEEL
    help
      Enable support for chassis.

if CHASSIS

module = CHASSIS
module-str = CHASSIS
source "subsys/logging/Kconfig.template.log_config"

config CHASSIS_LOG_LEVEL
    int "Motor log level"
    default 4
    help
      The log level of chassis driver

config CHASSIS_INIT_PRIORITY
	int "Chassis init priority"
	default 90
	help
	  The init priority of chassis driver

config CHASSIS_LATENCY_TRACE
	bool "Trace chassis control latency"
	default n
	help
	  Record and log chassis command age, timer wakeup latency and resolve
	  duration. Enable this only when chassis latency measurement is needed.

config CHASSIS_LATENCY_TRACE_LOG_INTERVAL_MS
	int "Chassis latency trace log interval in milliseconds"
	default 1000
	depends on CHASSIS_LATENCY_TRACE
	help
	  Minimum interval between repeated chassis latency trace logs.

endif
```

## dts/bindings/can/ares,test-can.yaml
```yaml
# SPDX-License-Identifier: Apache-2.0

description: Test CAN controller used by native_sim motor driver simulation tests.

compatible: "ares,test-can"

include: can-controller.yaml
```

## tests/native_sim/motor_driver_sim/testcase.yaml
```yaml
# SPDX-License-Identifier: Apache-2.0

tests:
  ares.native_sim.motor_driver_sim:
    tags:
      - ares
      - native_sim
      - motor
    platform_allow:
      - native_sim/native/64
    integration_platforms:
      - native_sim/native/64
```

## tests/native_sim/sbus/testcase.yaml
```yaml
# SPDX-License-Identifier: Apache-2.0

tests:
  ares.native_sim.sbus:
    tags:
      - ares
      - native_sim
      - sbus
    platform_allow:
      - native_sim/native/64
    integration_platforms:
      - native_sim/native/64
```
